#include <Arduino.h>
#include <SPI.h>
#include <Wire.h>
#include <Adafruit_GFX.h>
#include <Adafruit_SSD1306.h>
#define SCREEN_I2C_ADDR 0x3c // or 0x3C
#define SCREEN_WIDTH 128 // OLED display width, in pixels
#define SCREEN_HEIGHT 64 // OLED display height, in pixels
#define OLED_RESET -1 // Reset pin # (or -1 if sharing Arduino reset pin)
#define SCREEN_ADDRESS 0x3C ///< See datasheet for Address; 0x3D for 128x64, 0x3C for 128x32
Adafruit_SSD1306 display(SCREEN_WIDTH, SCREEN_HEIGHT, &Wire, -1);
int oledPinSda = 22;
int oledPinScl = 21;
int blinkPin = BUILTIN_LED;
void scan();


static const uint8_t image_data_Saraarray[1024] = {
    0xff, 0xff, 0xff, 0xff, 0xff, 0xff, 0xfe, 0x00, 0x00, 0x00, 0x1f, 0xff, 0xff, 0xff, 0xff, 0xff, 
    0xff, 0xff, 0xff, 0xff, 0xff, 0xff, 0xf8, 0x00, 0x00, 0x00, 0x0f, 0xff, 0xff, 0xff, 0xff, 0xff, 
    0xff, 0xff, 0xff, 0xff, 0xff, 0xff, 0xf8, 0x00, 0x00, 0x00, 0x07, 0xff, 0xff, 0xff, 0xff, 0xff, 
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    0xff, 0xff, 0xff, 0xff, 0x00, 0x00, 0x00, 0x1f, 0xff, 0xfc, 0x00, 0x00, 0x03, 0xff, 0xff, 0xff
};
 

void setup() {
  Serial.begin(115200);
  display.begin(SSD1306_SWITCHCAPVCC, 0x3C); // Address 0x3C for 128x32
  //Wire.begin(oledPinSda,oledPinScl);
  //if(!display.begin(SSD1306_SWITCHCAPVCC, 0x3C, false, false)) {
    //Serial.println(F("SSD1306 allocation failed"));
    //for(;;);
  //} 
  delay(2000);
  pinMode(BUILTIN_LED,OUTPUT);
  digitalWrite(BUILTIN_LED,HIGH);
  Serial.println("Beginne");
  
  
  // Clear the buffer.
  display.clearDisplay();
  
  // Draw bitmap on the screen
  //display.drawBitmap(0, 0, image_data_Saraarray, 128, 64, 1);
  //display.display();

// Beispiel einer Textausgabe:
		display.setTextColor(WHITE); display.setTextSize(1);
		display.setCursor(10, 0); display.println("Arduinospielwiese");

		// Beispiele für Ausgabe von Grafikelementen:
		display.drawLine(0, 20, 128, 20, WHITE);              // Linie
		display.drawCircle(10, 40, 10, WHITE);                // Kreis
		display.fillCircle(40, 40, 10, WHITE);                // Kreis, gefüllt
		display.drawRect(60, 30, 20, 20, WHITE);              // Rechteck
		display.drawTriangle(90, 30, 90, 50, 110, 40, WHITE); // Dreieck

		// Grafikpuffer auf dem OLED-Display ausgeben:
		display.display();

 }

void loop(){
  digitalWrite(BUILTIN_LED,HIGH);
  delay(500);
  digitalWrite(BUILTIN_LED,LOW);
  delay(500);
  scan();
}

void scan(){
  display.clearDisplay();
  byte error, address;
  int nDevices;
  nDevices = 0;
  for(address = 1; address < 127; address++ )
  {
    // The i2c_scanner uses the return value of
    // the Write.endTransmisstion to see if
    // a device did acknowledge to the address.
    Wire.beginTransmission(address);
    error = Wire.endTransmission();
    delay(100);
    if (error == 0)
    {
      Serial.print("I2C device found at address 0x");
      if (address<16)
      Serial.print("0");
      Serial.print(address,HEX);
      Serial.println("  !");
 
      nDevices++;
    }
    else if (error==4)
    {
      Serial.print("Unknown error at address 0x");
      if (address<16)
      Serial.print("0");
      Serial.println(address,HEX);
    }
    else
    {
      display.setTextColor(WHITE); display.setTextSize(2);
		  display.setCursor(10, 0); display.print("Nix gefunden an addresse 0x"); display.println(address);
      display.display();
      delay(500);
      display.clearDisplay();
    }    
  }


}